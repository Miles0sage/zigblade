## firmware/main/Kconfig.projbuild
```kconfig
menu "ZigBlade Configuration"

    config ZIGBLADE_DEFAULT_CHANNEL
        int "Default 802.15.4 channel"
        default 15
        range 11 26
        help
            IEEE 802.15.4 channel to start scanning on (11-26).

    choice ZIGBLADE_DISPLAY_TYPE
        prompt "Display type"
        default ZIGBLADE_DISPLAY_SSD1306
        help
            Select the display controller used for the OLED screen.

        config ZIGBLADE_DISPLAY_SSD1306
            bool "SSD1306 (128x64 I2C OLED)"
        config ZIGBLADE_DISPLAY_SH1106
            bool "SH1106 (128x64 I2C OLED)"
        config ZIGBLADE_DISPLAY_ST7735
            bool "ST7735 (128x160 SPI TFT)"
    endchoice

    config ZIGBLADE_I2C_SDA_PIN
        int "I2C SDA GPIO"
        default 5
        help
            GPIO pin for I2C SDA (OLED display).

    config ZIGBLADE_I2C_SCL_PIN
        int "I2C SCL GPIO"
        default 6
        help
            GPIO pin for I2C SCL (OLED display).

    config ZIGBLADE_SPI_MOSI_PIN
        int "SPI MOSI GPIO"
        default 7
        help
            GPIO pin for SPI MOSI (display / SD card).

    config ZIGBLADE_SPI_MISO_PIN
        int "SPI MISO GPIO"
        default 2
        help
            GPIO pin for SPI MISO (SD card).

    config ZIGBLADE_SPI_CLK_PIN
        int "SPI CLK GPIO"
        default 10
        help
            GPIO pin for SPI clock.

    config ZIGBLADE_SD_CS_PIN
        int "SD card CS GPIO"
        default 3
        help
            GPIO pin for SD card chip select.

    config ZIGBLADE_BTN_UP_PIN
        int "Button UP GPIO"
        default 9
        help
            GPIO pin for the UP navigation button.

    config ZIGBLADE_BTN_DOWN_PIN
        int "Button DOWN GPIO"
        default 4
        help
            GPIO pin for the DOWN navigation button.

    config ZIGBLADE_BTN_SELECT_PIN
        int "Button SELECT GPIO"
        default 8
        help
            GPIO pin for the SELECT / confirm button.

    config ZIGBLADE_BTN_BACK_PIN
        int "Button BACK GPIO"
        default 1
        help
            GPIO pin for the BACK / cancel button.

    config ZIGBLADE_LED_PIN
        int "WS2812B LED GPIO"
        default 0
        help
            GPIO pin for the WS2812B addressable LED.

    config ZIGBLADE_PCAP_MOUNT_POINT
        string "PCAP storage mount point"
        default "/sdcard"
        help
            VFS mount point for the SD card FAT partition used for PCAP capture files.

    config ZIGBLADE_MAX_PCAP_SIZE_MB
        int "Maximum PCAP file size (MB)"
        default 50
        range 1 512
        help
            Maximum size of a single PCAP capture file in megabytes.

endmenu
```

## firmware/sdkconfig.defaults
```kconfig
# -------------------------------------------------
# ZigBlade sdkconfig.defaults — ESP32-H2
# -------------------------------------------------

# Target
CONFIG_IDF_TARGET="esp32h2"

# Flash
CONFIG_ESPTOOLPY_FLASHSIZE_4MB=y
CONFIG_ESPTOOLPY_FLASHFREQ_48M=y

# Partition table
CONFIG_PARTITION_TABLE_CUSTOM=y
CONFIG_PARTITION_TABLE_CUSTOM_FILENAME="partitions.csv"

# IEEE 802.15.4
CONFIG_IEEE802154_ENABLED=y
CONFIG_IEEE802154_RX_BUFFER_SIZE=20

# FreeRTOS
CONFIG_FREERTOS_HZ=1000
CONFIG_FREERTOS_TIMER_TASK_STACK_DEPTH=4096
CONFIG_ESP_MAIN_TASK_STACK_SIZE=8192

# SPI
CONFIG_SPI_MASTER_IN_IRAM=y

# I2C
# (I2C is enabled by default via driver component)

# SD card — SPI mode
CONFIG_FATFS_LFN_HEAP=y
CONFIG_FATFS_MAX_LFN=255

# Hardware crypto accelerator
CONFIG_MBEDTLS_HARDWARE_AES=y
CONFIG_MBEDTLS_HARDWARE_SHA=y

# Log level
CONFIG_LOG_DEFAULT_LEVEL_INFO=y
CONFIG_LOG_DEFAULT_LEVEL=3

# Watchdog
CONFIG_ESP_TASK_WDT_TIMEOUT_S=10

# Optimisation
CONFIG_COMPILER_OPTIMIZATION_SIZE=y

# Enable LED strip RMT backend (WS2812B)
CONFIG_LED_STRIP_BACKEND_RMT=y
```

## tembed-firmware/sdkconfig.defaults
```kconfig
# ZigBlade T-Embed companion firmware defaults

CONFIG_IDF_TARGET="esp32s3"

CONFIG_ESPTOOLPY_FLASHSIZE_16MB=y
CONFIG_ESPTOOLPY_FLASHFREQ_80M=y
CONFIG_ESPTOOLPY_FLASHMODE_QIO=y

CONFIG_PARTITION_TABLE_SINGLE_APP=y

CONFIG_FREERTOS_HZ=1000
CONFIG_FREERTOS_TIMER_TASK_STACK_DEPTH=4096
CONFIG_ESP_MAIN_TASK_STACK_SIZE=8192

CONFIG_ESP_WIFI_SOFTAP_SUPPORT=y
CONFIG_ESP_WIFI_STATIC_RX_BUFFER_NUM=12
CONFIG_ESP_WIFI_DYNAMIC_RX_BUFFER_NUM=24

CONFIG_HTTPD_MAX_REQ_HDR_LEN=1024
CONFIG_HTTPD_MAX_URI_LEN=256

CONFIG_SPI_MASTER_IN_IRAM=y
CONFIG_GPIO_CTRL_FUNC_IN_IRAM=y

CONFIG_LOG_DEFAULT_LEVEL_INFO=y
CONFIG_LOG_DEFAULT_LEVEL=3

CONFIG_COMPILER_OPTIMIZATION_SIZE=y

CONFIG_LWIP_MAX_SOCKETS=10
CONFIG_LWIP_SO_REUSE=y
```
